## components/udp/Kconfig.projbuild
```kconfig
menu "CSHA UDP Config"
    config UDP_DEST_ADDRESS
        string "Ingestion Server Address"
        default "69.69.69.69"
        help
            The destination to ship bluetooth metrics to

    config UDP_DEST_PORT
        int "Ingestion Server Port"
        default 6666
        help
            The destination port to ship bluetooth metrics to
endmenu
```

## main/Kconfig.projbuild
```kconfig
menu "Main"
    config DEVICE_NUM
        hex "device number (last byte of address)"
        range 0x0 0xff
        default 0x0
        
        
endmenu
```
